// #include <stdint.h>
// #include "pico/stdlib.h"

// #define CONST_FREQ_ACCL 72057594037    // 周波数の加速定数（2^64 / 10^6 / 2^8）
// #define ARR_LEN 1024            // 波形配列の長さ
// #define PHASE_120_DEG 341       // 120度の位相ずれ（ARR_LEN / 3）
// #define PHASE_240_DEG 682       // 240度の位相ずれ（ARR_LEN / 3 * 2）
// #define GPIO_OUT_XOR 0xD000001C // GPIO XOR出力定数
// #define GPIO_OUT_SET 0xD0000014 // GPIO SET出力定数

// // GPIO関連
// #define GPIO_U 2    // U相の出力信号
// #define GPIO_V 3    // V相の出力信号
// #define GPIO_W 4    // W相の出力信号
// #define GPIO_SD 5   // シャットダウン信号

// #define SEQUENCE_ROW_LEN 64
// #define SEQUENCE_COL_LEN 5

// const int16_t sin_arr[ARR_LEN] = {0, 3, 6, 9, 12, 15, 18, 21, 25, 28, 31, 34, 37,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 -7, -4}; // 正弦波
// const int16_t tri_arr[ARR_LEN] = {0, -2, -4, -6, -8, -10, -12, -14, -16, -18, -20, -22, -24,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 4, 2}; // 三角波
// const int16_t saw_arr[ARR_LEN] = {-512, -511, -510, -509, -508, -507, -506, -505, -504, -503, -502, -501, -500,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 510, 511};  // ノコギリ波
// const int16_t wide_arr[ARR_LEN] = {511, 509, 506, 503, 500, 497, 494, 491, 488, 485, 482, 479, 476,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 -506, -509};  // 広域3パルス波形
// const uint16_t rand_arr[ARR_LEN] = {747, 849, 931, 877, 147, 781, 976, 511, 12, 765, 398, 577, 922,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 349, 44};    // 乱数配列

// volatile uint64_t motor_phase;  // モーターの位相（2^0 ~ 2^32-1）
// volatile uint64_t freq;         // モーターの周波数の変化量（f / s * 2^8）
// volatile uint64_t freq_delta;   // モーターの周波数（f / s * 2^8）
// volatile int16_t sin_u; // U相の出力波形
// volatile int16_t sin_v; // V相の出力波形
// volatile int16_t sin_w; // W相の出力波形
// volatile bool on_off;   // W相の出力波形


// uint16_t sequence_accl[SEQUENCE_ROW_LEN][SEQUENCE_COL_LEN];
// uint16_t sequence_decl[SEQUENCE_ROW_LEN][SEQUENCE_COL_LEN];

// uint32_t read_reg(uint32_t addr) {
//     return (*((volatile uint32_t *)addr));
// }

// void write_reg(uint32_t addr, uint32_t value) {
//     *((volatile uint32_t *)addr) = value;
// }

// // 変数初期化処理
// void init_var() {
//     motor_phase = 0;
//     freq = 256 * 1000;
//     freq_delta = 256;
//     on_off = 0;
//     for(int row = 0; row < SEQUENCE_ROW_LEN; row++){
        
//     }
// }

// // 1usごとの割り込み処理
// // bool timer_callback(struct repeating_timer *rt){
// //     write_reg(GPIO_OUT_XOR, 1UL << GPIO_U);
// //     //motor_phase += 1;//CONST_FREQ_ACCL * freq_accl;
// //     return 1;
// // }

// // メイン関数
// int main(void) {
//     stdio_init_all();

//     static repeating_timer_t timer;

//     init_var();

//     gpio_init(GPIO_U);
//     gpio_set_dir(GPIO_U, GPIO_OUT);
//     gpio_init(GPIO_V);
//     gpio_set_dir(GPIO_V, GPIO_OUT);
//     gpio_init(GPIO_W);
//     gpio_set_dir(GPIO_W, GPIO_OUT);
//     gpio_init(GPIO_SD);
//     gpio_set_dir(GPIO_SD, GPIO_OUT);

//     // add_repeating_timer_us(0, &timer_callback, NULL, &timer);
//     uint32_t before_timer = time_us_32();
//     while(1){
//         uint32_t now_timer = time_us_32();
//         if(now_timer != before_timer){
//             motor_phase += CONST_FREQ_ACCL * freq * (now_timer - before_timer);
//             sin_u = sin_arr[motor_phase >> 54];
//             sin_v = sin_arr[((motor_phase >> 54) + PHASE_240_DEG) & ARR_LEN];
//             sin_w = sin_arr[((motor_phase >> 54) + PHASE_120_DEG) & ARR_LEN];
//             int16_t carrier_u = sin_u;
//             int16_t carrier_v = sin_v;
//             int16_t carrier_w = sin_w;
//             gpio_put(GPIO_U, sin_u > 0);
//             gpio_put(GPIO_V, sin_v > 0);
//             gpio_put(GPIO_W, sin_w > 0);
//             gpio_put(GPIO_SD, 1);

//             before_timer = now_timer;
//         }
//         //write_reg(GPIO_OUT_XOR, 1UL << GPIO_U);
//         // メインループ
//         // sin_u = sin_arr[motor_phase >> 22];
//         // sin_v = sin_arr[((motor_phase >> 22) + PHASE_240_DEG) & ARR_LEN];
//         // sin_w = sin_arr[((motor_phase >> 22) + PHASE_120_DEG) & ARR_LEN];
//         // gpio_put(GPIO_U, sin_u > 0);
//         // gpio_put(GPIO_V, sin_v > 0);
//         // gpio_put(GPIO_W, sin_w > 0);
//         // gpio_put(GPIO_SD, 1);
//     }
// }

#include <stdio.h>
#include <inttypes.h>
#include "pico/stdlib.h"
#include "hardware/gpio.h"
#include "hardware/adc.h"

#define GPIO_U 8
#define GPIO_V 9
#define GPIO_W 10
#define GPIO_SD 11
// #define GPIO_PLS 12
// #define GPIO_DIR 13
#define ADC0_PIN 26
// #define GPIO_CLR 28

#define fs 40000.0
#define ARR_LEN 1024
#define LEN(array) (sizeof(array) / sizeof(array[0]))

void gpio_interrupt_callback(uint gpio, uint32_t emask);

int pulse_mode = 0;      // パルスモード
float modulated_freq = 0;  // 変調波（モーターの周波数）
float carrier_freq = 0;  // 搬送波（スイッチング周波数）

float voltage = 0;
float adc_accl = 0;
int adc_val = 0;
float accl = 0;
int sin_arr[ARR_LEN] = {0, 3, 6, 9, 12, 15, 18, 21, 25, 28, 31, 34, 37,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 -7, -4};
int tri_arr[ARR_LEN] = {0, -2, -4, -6, -8, -10, -12, -14, -16, -18, -20, -22, -24,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 4, 2};
int saw_arr[ARR_LEN] = {-512, -511, -510, -509, -508, -507, -506, -505, -504, -503, -502, -501, -500,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 510, 511};
int wide_arr[ARR_LEN] = {511, 509, 506, 503, 500, 497, 494, 491, 488, 485, 482, 479, 476,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 -506, -509};
unsigned int rand_arr[ARR_LEN] = {747, 849, 931, 877, 147, 781, 976, 511, 12, 765, 398, 577, 922,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 349, 44};
//float sqrt_arr[ARR_LEN] = {0, 0.5, 0.71, 0.87, 1, 1.12, 1.22, 1.32, 1.41, 1.5, 1.58, 1.66, 1.73,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 15.98, 15.99};

// 227系500番台 東洋IGBT
/*float sequence_accl[][7] = {
    {0, 1, 0, 1045, 1045, 0, 0},
    {42, 0, 0, 9, 9, 0, 0},
    {120, 0, 0, 1, 1, 0, 0}
};
float sequence_decl[][7] = {
    {0, 1, 0, 1045, 1045, 0, 0},
    {42, 0, 0, 9, 9, 0, 0},
    {120, 0, 0, 1, 1, 0, 0}
};*/

// 223系5000番台 三菱IGBT
/*float sequence_accl[][7] = {
    {0, 1, 2, 480, 1700, 0.01, 0},
    {20, 1, 2, 760, 1300, 0.01, 0},
    {45, 1, 2, 1300, 1300, 0.01, 0},
    {60, 0, 0, 5, 5, 0, 0},
    {63, 0, 0, 3, 3, 0, 0},
    {65, 0, 1, 3, 3, 0, 0},
    {70, 0, 0, 1, 1, 0, 0}
};
float sequence_decl[][7] = {
    {0, 1, 2, 480, 1700, 0.01, 0},
    {20, 1, 2, 760, 1300, 0.01, 0},
    {45, 1, 2, 1300, 1300, 0.01, 0},
    {60, 0, 0, 5, 5, 0, 0},
    {63, 0, 0, 3, 3, 0, 0},
    {65, 0, 1, 3, 3, 0, 0},
    {70, 0, 0, 1, 1, 0, 0}
};*/

/*float sequence_accl[][7] = {
    {0, 1, 0, 740, 740, 0, 0},
    {23, 1, 0, 740, 700, 0, 0},
    {43, 1, 0, 700, 1800, 0, 0},
    {54, 0, 1, 3, 3, 0, 0},
    {57, 0, 0, 1, 1, 0, 0}
};
float sequence_decl[][7] = {
    {0, 1, 0, 200, 200, 0, 0},
    {4, 1, 0, 740, 740, 0, 0},
    {28, 1, 0, 740, 700, 0, 0},
    {54, 1, 0, 700, 1700, 0, 0},
    {68, 0, 1, 3, 3, 0, 0},
    {73, 0, 0, 1, 1, 0, 0}
};*/

// 京急1000系 シーメンスGTO
float sequence_accl[][7] = {
    {0, 1, 0, 175, 175, 0, 0},
    {0.7, 1, 0, 196, 196, 0, 0},
    {1.4, 1, 0, 223, 223, 0, 0},
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    {80, 0, 0, 1, 1, 0, 0}
};
float sequence_decl[][7] = {
    {0, 1, 0, 400, 400, 0, 0},
    {22, 0, 0, 18, 18, 0, 0},
    {26, 0, 0, 15, 15, 0, 0},
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    {80, 0, 0, 1, 1, 0, 0}
};

// 鉄道唱歌
/*float sequence_accl[][7] = {
    {0, 1, 0, 784, 784, 0, 0},
    {7, 1, 0, 880, 880, 0, 0},
    {8, 1, 0, 988, 988, 0, 0},
    {15, 1, 0, 880, 880, 0, 0},
    {16, 1, 0, 784, 784, 0, 0},
    {23, 1, 0, 659, 659, 0, 0},
    {24, 1, 0, 587, 587, 0, 0},
    {32, 1, 0, 659, 659, 0, 0},
    {36, 1, 0, 587, 587, 0, 0},
    {39, 1, 0, 659, 659, 0, 0},
    {40, 1, 0, 784, 784, 0, 0},
    {44, 1, 0, 988, 988, 0, 0},
    {48, 1, 0, 880, 880, 0, 0},
    {52, 1, 0, 988, 988, 0, 0},
    {55, 1, 0, 880, 880, 0, 0},
    {56, 1, 0, 784, 784, 0, 0},
    {64, 0, 0, 3, 3, 0, 0},
    {70, 0, 1, 3, 3, 0, 0},
    {80, 0, 0, 1, 1, 0, 0}
};
float sequence_decl[][7] = {
    {0, 1, 0, 784, 784, 0, 0},
    {8, 1, 0, 880, 880, 0, 0},
    {9, 1, 0, 988, 988, 0, 0},
    {12, 1, 0, 880, 880, 0, 0},
    {16, 1, 0, 988, 988, 0, 0},
    {20, 1, 0, 784, 784, 0, 0},
    {24, 1, 0, 659, 659, 0, 0},
    {25, 1, 0, 587, 587, 0, 0},
    {28, 1, 0, 659, 659, 0, 0},
    {32, 1, 0, 587, 587, 0, 0},
    {40, 1, 0, 659, 659, 0, 0},
    {41, 1, 0, 784, 784, 0, 0},
    {48, 1, 0, 880, 880, 0, 0},
    {49, 1, 0, 988, 988, 0, 0},
    {56, 1, 0, 880, 880, 0, 0},
    {57, 1, 0, 784, 784, 0, 0},
    {64, 0, 0, 3, 3, 0, 0},
    {70, 0, 1, 3, 3, 0, 0},
    {80, 0, 0, 1, 1, 0, 0}
};*/

// ファミリーマート入店音
/*float sequence_accl[][7] = {
    {0, 1, 0, 494, 494, 0, 0},
    {2, 1, 0, 392, 392, 0, 0},
    {4, 1, 0, 294, 294, 0, 0},
    {6, 1, 0, 392, 392, 0, 0},
    {8, 1, 0, 440, 440, 0, 0},
    {10, 1, 0, 587, 587, 0, 0},
    {14, 1, 0, 294, 294, 0, 0},
    {16, 1, 0, 440, 440, 0, 0},
    {18, 1, 0, 494, 494, 0, 0},
    {20, 1, 0, 440, 440, 0, 0},
    {22, 1, 0, 294, 294, 0, 0},
    {24, 1, 0, 392, 392, 0, 0},
    {32, 0, 0, 3, 3, 0, 0},
    {46, 0, 1, 3, 3, 0, 0},
    {60, 0, 0, 1, 1, 0, 0}
};
float sequence_decl[][7] = {
    {0, 1, 0, 392, 392, 0, 0},
    {8, 1, 0, 294, 294, 0, 0},
    {10, 1, 0, 440, 440, 0, 0},
    {12, 1, 0, 494, 494, 0, 0},
    {14, 1, 0, 440, 440, 0, 0},
    {16, 1, 0, 294, 294, 0, 0},
    {18, 1, 0, 587, 587, 0, 0},
    {22, 1, 0, 440, 440, 0, 0},
    {24, 1, 0, 392, 392, 0, 0},
    {26, 1, 0, 294, 294, 0, 0},
    {28, 1, 0, 392, 392, 0, 0},
    {30, 1, 0, 494, 494, 0, 0},
    {32, 0, 0, 3, 3, 0, 0},
    {46, 0, 1, 3, 3, 0, 0},
    {60, 0, 0, 1, 1, 0, 0}
};*/

// 東武30000系 東芝IGBT
/*float sequence_accl[][7] = {
    {0, 1, 0, 1000, 1000, 0, 4.0},
    {16, 1, 0, 1000, 1000, 0, 0},
    {102, 0, 0, 5, 5, 0, 0},
    {116, 0, 0, 3, 3, 0, 0},
    {124, 0, 0, 1, 1, 0, 0}
};
float sequence_decl[][7] = {
    {0, 1, 0, 1000, 1000, 0, 4.0},
    {16, 1, 0, 1000, 1000, 0, 0},
    {102, 0, 0, 5, 5, 0, 0},
    {116, 0, 0, 3, 3, 0, 0},
    {124, 0, 0, 1, 1, 0, 0}
};*/

/*float sequence_accl[][7] = {
    {0, 1, 0, 10000, 10000, 0, 0},
    {100, 0, 0, 1, 1, 0, 0}
};
float sequence_decl[][7] = {
    {0, 1, 0, 10000, 10000, 0, 0},
    {100, 0, 0, 1, 1, 0, 0}
};*/

float sequence_arr[32][7];
unsigned int sequence_accl_len = LEN(sequence_accl);
unsigned int sequence_decl_len = LEN(sequence_decl);
unsigned int sequence_arr_len = 0;

// データ形式 [開始しきい値, モード（0: 同期モード, 1: 非同期モード, 2: 中立モード）, キャリアタイプ（0: 三角波, 1: 広域, 2: ランダム, 4: 重畳, 6: ランダム+重畳）, 同期モードの場合はパルスモード、非同期モードの場合は開始周波数, 非同期モードの場合は終了周波数]

float phase_u = 0;     // 変調波の位相（モーター用）
float async_phase = 0; // 非同期モード時の搬送波の位相
float async_random_phase = 0;  // 非同期モード時の搬送波のランダム位相
float async_superimposed_phase = 0;    // 非同期モード時の搬送波の重畳位相
unsigned int i = 0;
unsigned int j = 0;
unsigned long t = 0;
unsigned int random_index = 0;
float phase_v_add = (float)ARR_LEN * 2.0 / 3.0;
float phase_w_add = (float)ARR_LEN * 1.0 / 3.0;
float sampling_freq = 1.0 / fs;

bool timer_callback(repeating_timer_t *rt){
    t++;
    random_index++;
    if(random_index >= ARR_LEN){
        random_index = 0;
    }
    unsigned char motor_on_flag = 1;    // モーターのONフラグ

    float accl_buf = accl;
    accl = adc_accl;

    /*if(t < 5 * fs){
        accl = 2;
    }
    else if (t < 25 * fs){
        accl = 5;
    }
    else if (t < 30 * fs){
        accl = 0;
    }
    else if (t < 50 * fs){
        accl = -5;
    }
    else {
        accl = -2;
    }*/
    if(accl >= 0 && accl_buf < 0){
        sequence_arr_len = sequence_accl_len;
        for(i = 0; i < sequence_arr_len; i++){
            for(j = 0; j < 7; j++){
                sequence_arr[i][j] = sequence_accl[i][j];
            }
        }
    }
    else if(accl < 0 && accl_buf >= 0){
        sequence_arr_len = sequence_decl_len;
        for(i = 0; i < sequence_arr_len; i++){
            for(j = 0; j < 7; j++){
                sequence_arr[i][j] = sequence_decl[i][j];
            }
        }
    }

    modulated_freq += accl * sampling_freq; // 変調波周波数（モーターの周波数）
    if (accl == 0) {
        // 加速度0の場合は徐々に減速するので周波数を徐々に落とす
        modulated_freq -= 4.0 * sampling_freq;
    }
    if(modulated_freq < 0){
        modulated_freq = 0;
        motor_on_flag = 0;
    }
    // 位相算出
    phase_u += modulated_freq * (float)ARR_LEN * sampling_freq;
    while (phase_u >= ARR_LEN){
      phase_u -= (float)ARR_LEN;
    }
    float phase_v = phase_u + phase_v_add;
    float phase_w = phase_u + phase_w_add;
    if (phase_v >= ARR_LEN){
      phase_v -= (float)ARR_LEN;
    }
    if (phase_w >= ARR_LEN){
      phase_w -= (float)ARR_LEN;
    }
    // サイン波形算出
    int sin_u = sin_arr[(unsigned int)phase_u % ARR_LEN];
    int sin_v = sin_arr[(unsigned int)phase_v % ARR_LEN];
    int sin_w = sin_arr[(unsigned int)phase_w % ARR_LEN];

    /*if (sin_u >= 0){
        sin_u = min(sin_u + 32, 511);
    }*/

    // キャリア波形の初期化（電圧を出さない）
    int carrier_u = sin_u;
    int carrier_v = sin_v;
    int carrier_w = sin_w;
    // シーケンス番号選択処理
    unsigned int sequence_index = sequence_arr_len - 1;
    for (i = 0; i < sequence_arr_len; i++){
        if (modulated_freq < sequence_arr[i][0]){
            sequence_index = i - 1;
            break;
        }
    }
    if (sequence_arr[sequence_index][1] == 0){
        // 同期モード
        pulse_mode = sequence_arr[sequence_index][3];   // パルスモード
        /*if (pulse_mode >= 9 && pulse_mode <= 17){
            pulse_mode += 4;
        }*/
        if (pulse_mode == 1) {
            carrier_u = 0;
            carrier_v = 0;
            carrier_w = 0;
        }
        else if (sequence_arr[sequence_index][2] == 0){
            carrier_u = tri_arr[(unsigned int)(phase_u * (float)(pulse_mode)) % ARR_LEN];
            /*if (((pulse_mode - 1) / 2) % 2 != 0){
                carrier_u *= -1;
            }*/
            carrier_v = carrier_u;
            carrier_w = carrier_u;
            /*if (pulse_mode >= 13 && pulse_mode <= 21){
                int pulse_cut_level = sin_arr[(unsigned int)((float)(ARR_LEN) / (float)(pulse_mode) * (((float)(pulse_mode) - 5.0) / 12.0 + 1.5)) % ARR_LEN];
                
                if (sin_u >= 0){
                    if (sin_u < pulse_cut_level){
                        sin_u = 0;
                    }
                }
                else{
                    if (-sin_u < pulse_cut_level){
                        sin_u = 0;
                    }
                }
                if (sin_v >= 0){
                    if (sin_v < pulse_cut_level){
                        sin_v = 0;
                    }
                }
                else{
                    if (-sin_v < pulse_cut_level){
                        sin_v = 0;
                    }
                }
                if (sin_w >= 0){
                    if (sin_w < pulse_cut_level){
                        sin_w = 0;
                    }
                }
                else{
                    if (-sin_w < pulse_cut_level){
                        sin_w = 0;
                    }
                }
                sin_u = sin_u * 3 / 2;
                sin_v = sin_v * 3 / 2;
                sin_w = sin_w * 3 / 2;
            }*/
        }
        else{
            // 広域パルスモード
            carrier_u = wide_arr[(unsigned int)phase_u % ARR_LEN];
            carrier_v = wide_arr[(unsigned int)phase_v % ARR_LEN];
            carrier_w = wide_arr[(unsigned int)phase_w % ARR_LEN];
            sin_u = (sin_u >= 0) * (ARR_LEN - 1) - ARR_LEN / 2;
            sin_v = (sin_v >= 0) * (ARR_LEN - 1) - ARR_LEN / 2;
            sin_w = (sin_w >= 0) * (ARR_LEN - 1) - ARR_LEN / 2;
        }
    }
    else if (sequence_arr[sequence_index][1] == 1){
        // 非同期モード
        float carrier_start_freq = sequence_arr[sequence_index][3];   // 搬送波の開始周波数
        carrier_freq = carrier_start_freq;                       // 搬送波の周波数（スイッチング周波数）
        if (sequence_index < sequence_arr_len - 1){
            float carrier_end_freq = sequence_arr[sequence_index][4]; // 搬送波の終了周波数
            float modulated_start_freq = sequence_arr[sequence_index][0];     // 変調波の開始周波数
            float modulated_end_freq = sequence_arr[sequence_index + 1][0];   // 変調波の終了周波数
            carrier_freq += 1.0 / (modulated_end_freq - modulated_start_freq) * (carrier_end_freq - carrier_start_freq) * (modulated_freq - modulated_start_freq);
        }
        async_phase += carrier_freq * (float)ARR_LEN * sampling_freq;  // 非同期モードの位相
        if (async_phase >= ARR_LEN){
            async_random_phase = rand_arr[random_index];
            while (async_phase >= ARR_LEN){
                async_phase -= (float)ARR_LEN;
            }
        }
        
        
        float async_custom_phase = async_phase;
        if (sequence_arr[sequence_index][5] > 0){
            // ランダム変調
            async_custom_phase += async_random_phase * sequence_arr[sequence_index][5];
        }
        if (sequence_arr[sequence_index][6] >= 1.0){
            // 高周波重畳の位相
            async_superimposed_phase += carrier_freq * (float)ARR_LEN * sampling_freq / (sequence_arr[sequence_index][6] * 2.0);
            if (async_superimposed_phase >= ARR_LEN){
                while (async_superimposed_phase >= ARR_LEN){
                    async_superimposed_phase -= (float)ARR_LEN;
                }
            }
            // 高周波重畳
            sin_u *= (sin_arr[(unsigned int)(async_superimposed_phase) % ARR_LEN] >= 0) * 3 - 1;
            sin_v *= (sin_arr[(unsigned int)(async_superimposed_phase) % ARR_LEN] >= 0) * 3 - 1;
            sin_w *= (sin_arr[(unsigned int)(async_superimposed_phase) % ARR_LEN] >= 0) * 3 - 1;
        }
        carrier_u = tri_arr[(unsigned int)async_custom_phase % ARR_LEN];
        carrier_v = carrier_u;
        carrier_w = carrier_u;
    }
    else {
        // 中立モード
        motor_on_flag = 0;
    }

    if (motor_on_flag == 1 && modulated_freq != 0) {
        // モータ運転
        if (accl == 0) {    // 加速度0で惰行、それ以外は力行
            // 力行から惰行への移行処理
            if (sequence_arr[sequence_index][1] == 0 && pulse_mode == 1) {
                // パルスモードが同期1パルスモードの場合は3パルスにする
                carrier_u = tri_arr[(unsigned int)(phase_u * 3.0) % ARR_LEN];
                carrier_v = carrier_u;
                carrier_w = carrier_u;
            }
            // 力行から惰行になったときは電圧を徐々に下げる
            voltage -= 2.0 * sampling_freq;
        }
        else {
            if (modulated_freq / 80.0 < voltage) {    // 電圧計算条件の場合分け
                // モータは力行
                voltage = modulated_freq / 80.0 + 0.1; // 力行の電圧計算
            }
            else {
                // 惰行から力行への移行処理
                if (sequence_arr[sequence_index][1] == 0 && pulse_mode == 1) {
                    // パルスモードが同期1パルスモードの場合は3パルスにする
                    carrier_u = tri_arr[(unsigned int)(phase_u * 3.0) % ARR_LEN];
                    carrier_v = carrier_u;
                    carrier_w = carrier_u;
                }
                // 惰行から力行になったときは電圧を徐々に上げる
                voltage += 2.0 * sampling_freq;
            }
        }

        if (voltage > 1.0) {
            voltage = 1.0;
        }
        char pwm_u = 0;
        char pwm_v = 0;
        char pwm_w = 0;
        if (voltage > 0) {
            pwm_u = sin_u * voltage > carrier_u;
            pwm_v = sin_v * voltage > carrier_v;
            pwm_w = sin_w * voltage > carrier_w;
        }
        else {
            voltage = 0;
        }
        // syn_uv, syn_vw, syn_wu をデジタル出力する
        gpio_put(GPIO_U, pwm_u);
        gpio_put(GPIO_V, pwm_v);
        gpio_put(GPIO_W, pwm_w);
        gpio_put(GPIO_SD, 1);
    }
    else {
        // モータ停止
        gpio_put(GPIO_U, 0);
        gpio_put(GPIO_V, 0);
        gpio_put(GPIO_W, 0);
        gpio_put(GPIO_SD, 0);
    }
    return 1;
}

int main(){
    stdio_init_all();

    set_sys_clock_khz(250000, true);    // 動作クロック設定

    static repeating_timer_t timer;

    /*
    GPIO初期化処理
    */

    // GPIOを出力に設定
    gpio_init(GPIO_U);
    gpio_set_dir(GPIO_U, GPIO_OUT);
    gpio_init(GPIO_V);
    gpio_set_dir(GPIO_V, GPIO_OUT);
    gpio_init(GPIO_W);
    gpio_set_dir(GPIO_W, GPIO_OUT);
    gpio_init(GPIO_SD);
    gpio_set_dir(GPIO_SD, GPIO_OUT);
    gpio_init(GPIO_SD);

    // GPIOを入力に設定
    //gpio_init(GPIO_PLS);
    //gpio_set_dir(GPIO_PLS, GPIO_IN);
    

    for(i = 0; i <= 7; i++){
        gpio_init(i);
        gpio_set_dir(i, GPIO_OUT);
        gpio_put(i, 0);
    }
    for(i = 12; i <= 22; i++){
        gpio_init(i);
        gpio_set_dir(i, GPIO_OUT);
        gpio_put(i, 0);
    }
    /*for(i = 26; i <= 28; i++){
        gpio_init(i);
        gpio_set_dir(i, GPIO_OUT);
        gpio_put(i, 0);
    }*/
    gpio_init(25);
    gpio_set_dir(25, GPIO_OUT);
    gpio_put(25, 1);

    adc_init();
    adc_gpio_init(ADC0_PIN);                //ADC0(GPIO26)の端子設定
    adc_select_input(0);                    

    // リセットパルスを出力
    /*gpio_put(GPIO_CLR, 0);
    sleep_ms(1000);
    gpio_put(GPIO_CLR, 1);
    sleep_ms(10);
    gpio_put(GPIO_CLR, 0);*/

    sequence_arr_len = sequence_accl_len;
    for(i = 0; i < sequence_arr_len; i++){
        for(j = 0; j < 5; j++){
            sequence_arr[i][j] = sequence_accl[i][j];
        }
    }

    add_repeating_timer_us(-1000000 / fs, &timer_callback, NULL, &timer);
    // gpio_set_irq_enabled_with_callback(GPIO_PLS, GPIO_IRQ_EDGE_FALL, true, gpio_interrupt_callback);
    while(1){
        gpio_put(25, 1);
        adc_val = (int)(adc_read()) / 342 - 6;

        adc_accl = (float)(adc_val); // * 2.0;
        if(adc_accl > -0.1 && adc_accl < 0.1){
            adc_accl = 0;
        }
        sleep_ms(100);
        gpio_put(25, 0);
        sleep_ms(100);
    }
}