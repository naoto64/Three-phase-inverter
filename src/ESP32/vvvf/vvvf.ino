#define U_PIN_IN 33
#define U_PIN_SD 25
#define V_PIN_IN 26
#define V_PIN_SD 27
#define W_PIN_IN 14
#define W_PIN_SD 12

#define TABLE_LEN 256
#define CTRL_RATE 20000
#define FREQ_LEN 9

hw_timer_t * timer = NULL;

// 非同期モードの周波数配列
const double freq_table[FREQ_LEN] = {175, 196, 223, 233, 262, 294, 311, 350, 400};
// 変調波（正弦波・交流波形）
const double sin_table[TABLE_LEN] = {0, 6.258, 12.512, 18.759, 24.994, 31.215, 37.416, 43.595, 49.748, 55.871, 61.96, 68.012, 74.023,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 -12.512, -6.258};
// 搬送波（三角波・制御波形）
const double tri_table[TABLE_LEN] = {0, -6.259, -12.517, -18.776, -25.035, -31.293, -37.552, -43.81, -50.069, -56.328, -62.586, -68.845, -75.104,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 12.517, 6.259};
double sin_index = 0; // 正弦波の位相（0-255）
double tri_index = 0; // 三角波の位相（0-255）
double freq = 0;      // 変調波の周波数
double ctrl_freq = 0; // 非同期モードの周波数
double ctrl_freq_index = 0; // 非同期モードの周波数のインデックス
double voltage = 0;  // 出力電圧
unsigned char sync_mode = 0;  // 0: 非同期モード, 1: 同期モード
unsigned char pulse_mode = 0;  // パルスモード

char U_IN_FLAG = LOW; // U相の出力
char V_IN_FLAG = LOW; // V相の出力
char W_IN_FLAG = LOW; // W相の出力
int accel = 0;

void IRAM_ATTR onTimer() {
  // 出力波形の周波数を計算
  freq = min(max(freq + (double)accel * 0.5 / (double)CTRL_RATE, 0.0), 120.0);
  // 電圧を計算
  voltage = min(0.06 + freq / 80.0, 1.0);
  // 正弦波の位相を計算
  sin_index += (double)TABLE_LEN * freq / (double)CTRL_RATE;
  
  // 非同期モード（加速）
  if(freq < 24.0 && accel > 0){
    sync_mode = 0;
    // 非同期モードの周波数を計算
    ctrl_freq_index = min(freq * 2.0, (double)FREQ_LEN - 1.0);
    ctrl_freq = freq_table[((unsigned int)ctrl_freq_index) % FREQ_LEN];
    // 非同期モードの位相を計算
    tri_index += (double)TABLE_LEN * ctrl_freq / (double)CTRL_RATE;
  }
  // 非同期モード（減速）
  else if(freq < 24.0){
    sync_mode = 0;
    // 非同期モードの周波数を400Hz固定にする
    ctrl_freq = freq_table[FREQ_LEN - 1];
    // 非同期モードの位相を計算
    tri_index += (double)TABLE_LEN * ctrl_freq / (double)CTRL_RATE;
  }
  // 同期モード
  else{
    sync_mode = 1;
    // パルスモードの設定
    if(freq > 80){
      pulse_mode = 1;
    }
    else if(freq > 58){
      pulse_mode = 3;
    }
    else if(freq > 56){
      pulse_mode = 5;
    }
    else if(freq > 44){
      pulse_mode = 7;
    }
    else if(freq > 36){
      pulse_mode = 9;
    }
    else if(freq > 30){
      pulse_mode = 11;
    }
    else if(freq > 26){
      pulse_mode = 13;
    }
    else{
      pulse_mode = 15;
    }
    // 三角波の位相を計算
    tri_index = sin_index * pulse_mode;
  }

  // 位相が1周したら1周分を引く
  while(sin_index >= TABLE_LEN){
    sin_index -= (double)TABLE_LEN;
  }
  while(tri_index >= TABLE_LEN){
    tri_index -= (double)TABLE_LEN;
  }

  // 正弦波が三角波より大きいときは出力ON（U相）
  if(sin_table[((unsigned int)sin_index) % TABLE_LEN] * voltage > tri_table[((unsigned int)tri_index) % TABLE_LEN]){
    U_IN_FLAG = HIGH;
  }
  else{
    U_IN_FLAG = LOW;
  }

  // 正弦波が三角波より大きいときは出力ON（V相）
  if(sin_table[((unsigned int)sin_index + TABLE_LEN / 3) % TABLE_LEN] * voltage > tri_table[((unsigned int)tri_index) % TABLE_LEN]){
    V_IN_FLAG = HIGH;
  }
  else{
    V_IN_FLAG = LOW;
  }

  // 正弦波が三角波より大きいときは出力ON（W相）
  if(sin_table[((unsigned int)sin_index + TABLE_LEN * 2 / 3) % TABLE_LEN] * voltage > tri_table[((unsigned int)tri_index) % TABLE_LEN]){
    W_IN_FLAG = HIGH;
  }
  else{
    W_IN_FLAG = LOW;
  }

  // 周波数が1Hzより大きくまたは加速しているときは出力ON
  if(accel > 0 || freq > 1.0){
    digitalWrite(U_PIN_SD, HIGH);
    digitalWrite(V_PIN_SD, HIGH);
    digitalWrite(W_PIN_SD, HIGH);
    digitalWrite(U_PIN_IN, U_IN_FLAG);
    digitalWrite(V_PIN_IN, V_IN_FLAG);
    digitalWrite(W_PIN_IN, W_IN_FLAG);
  }
  // 周波数1Hz以下で停止または減速しているときは停止
  else{
    // リセット処理
    sin_index = 0;
    tri_index = 0;
    freq = 0;
    ctrl_freq = 0;
    ctrl_freq_index = 0;
    voltage = 0;
    sync_mode = 0;
    digitalWrite(U_PIN_SD, LOW);
    digitalWrite(V_PIN_SD, LOW);
    digitalWrite(W_PIN_SD, LOW);
    digitalWrite(U_PIN_IN, LOW);
    digitalWrite(V_PIN_IN, LOW);
    digitalWrite(W_PIN_IN, LOW);
  }
}

void setup() {
  // ウォッチドッグタイマ無効
  disableCore0WDT();
  disableCore1WDT();
  // 出力モードに設定
  pinMode(U_PIN_IN, OUTPUT);
  pinMode(V_PIN_IN, OUTPUT);
  pinMode(W_PIN_IN, OUTPUT);
  pinMode(U_PIN_SD, OUTPUT);
  pinMode(V_PIN_SD, OUTPUT);
  pinMode(W_PIN_SD, OUTPUT);
  // タイマー割り込みの設定
  timer = timerBegin(0, 80, true);
  timerAttachInterrupt(timer, &onTimer, true);
  timerAlarmWrite(timer, 1000000 / CTRL_RATE, true);
  timerAlarmEnable(timer);
}

void loop() {
  // 加速制御
  int acl_val = analogRead(32);
  if(acl_val > 4096.0 * 0.85){
    accel = 5;
  }
  else if(acl_val > 4096.0 * 0.7){
    accel = 3;
  }
  else if(acl_val > 4096.0 * 0.6){
    accel = 1.5;
  }
  else if(acl_val > 4096.0 * 0.3){
    accel = 0;
  }
  else if(acl_val > 4096.0 * 0.25){
    accel = -1;
  }
  else if(acl_val > 4096.0 * 0.2){
    accel = -2;
  }
  else if(acl_val > 4096.0 * 0.15){
    accel = -3;
  }
  else if(acl_val > 4096.0 * 0.1){
    accel = -4;
  }
  else{
    accel = -5;
  }
}